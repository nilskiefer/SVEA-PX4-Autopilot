## src/drivers/gpio/pcal6524/Kconfig
```kconfig
menuconfig DRIVERS_GPIO_PCAL6524
	bool "PCAL6524"
	default n
	---help---
		Enable support for PCAL6524 24-bit GPIO expander
```

## src/drivers/imu/st/ism330dlc/Kconfig
```kconfig
menuconfig DRIVERS_IMU_ST_ISM330DLC
	bool "ism330dlc"
	default n
	---help---
		Enable support for ST ISM330DLC IMU
```

## src/drivers/imu/st/lsm6dsox/Kconfig
```kconfig
menuconfig DRIVERS_IMU_ST_LSM6DSOX
	bool "lsm6dsox"
	default n
	---help---
		Enable support for ST LSM6DSOX IMU
```

## src/drivers/power_monitor/svea_ina226/Kconfig
```kconfig
menuconfig DRIVERS_POWER_MONITOR_SVEA_INA226
	bool "svea_ina226"
default n
	---help---
		Enable support for SVEA INA226
```

## src/drivers/power_monitor/svea_ina3221/Kconfig
```kconfig
menuconfig DRIVERS_POWER_MONITOR_SVEA_INA3221
	bool "svea_ina3221"
default n
	---help---
		Enable support for SVEA INA3221
```

## src/drivers/smart_battery/bq769x2/Kconfig
```kconfig
menuconfig DRIVERS_SMART_BATTERY_BQ769X2
	bool "bq769x2"
	default n
	---help---
		Enable support for TI BQ769x2 smart battery monitor (BQ76942/BQ76952 family).
```

## src/drivers/svea_mppt/Kconfig
```kconfig
menuconfig DRIVERS_SVEA_MPPT
	bool "svea_mppt"
	default n
	depends on PLATFORM_NUTTX
	depends on DRIVERS_GPIO_PCAL6524
	---help---
		PMB3 TPL0401B MPPT setpoint and GPIO6 bypass control.
```

## src/examples/button_led_mirror/Kconfig
```kconfig
menuconfig EXAMPLES_BUTTON_LED_MIRROR
	bool "button_led_mirror"
	default n
	---help---
		Enable support for button_led_mirror
```

## src/examples/led_bus_worker/Kconfig
```kconfig
menuconfig EXAMPLES_LED_BUS_WORKER
	bool "led_bus_worker"
	default n
	---help---
		Enable support for led_bus_worker
```

## src/examples/led_pattern/Kconfig
```kconfig
menuconfig EXAMPLES_LED_PATTERN
	bool "led_pattern"
	default n
	---help---
		Enable support for led_pattern
```

## src/examples/neopixel_fx/Kconfig
```kconfig
menuconfig EXAMPLES_NEOPIXEL_FX
	bool "neopixel_fx"
	default n
	---help---
		Enable support for neopixel_fx
```

## src/modules/simulation/svea_sitl/Kconfig
```kconfig
menuconfig MODULES_SIMULATION_SVEA_SITL
	bool "svea_sitl"
	default n
	---help---
		Enable SVEA SITL helper module for RC fallback and rover frame bridge.
```

## src/modules/svea_baro_sim/Kconfig
```kconfig
menuconfig MODULES_SVEA_BARO_SIM
	bool "svea_baro_sim"
	default n
	depends on PLATFORM_NUTTX
	---help---
		Enable the SVEA board test publisher for the standard sensor_baro uORB topic.
```

## src/modules/svea_encoder_uart/Kconfig
```kconfig
menuconfig MODULES_SVEA_ENCODER_UART
	bool "svea_encoder_uart"
	default n
	---help---
		Enable support for SVEA encoder UART peripheral ingest.
```

## src/modules/svea_lli/Kconfig
```kconfig
menuconfig MODULES_SVEA_LLI
	bool "svea_lli"
	default n
	depends on PLATFORM_NUTTX
	---help---
		SVEA low-level interface module with PX4-native RC/failsafe handling
		that publishes actuator_motors/actuator_servos setpoints into the
		standard PX4 actuator pipeline.
```

## src/modules/svea_peripheral_mcu/Kconfig
```kconfig
menuconfig MODULES_SVEA_PERIPHERAL_MCU
	bool "svea_peripheral_mcu"
	default n
	---help---
		Enable support for SVEA peripheral MCU bridge ingest.
```

## src/modules/svea_power_gate/Kconfig
```kconfig
menuconfig MODULES_SVEA_POWER_GATE
	bool "svea_power_gate"
	default n
	depends on PLATFORM_NUTTX
	---help---
		Enable support for SVEA power-gate arming helper.
```

## src/modules/svea_rc_servo_latch/Kconfig
```kconfig
menuconfig MODULES_SVEA_RC_SERVO_LATCH
	bool "svea_rc_servo_latch"
	default n
	---help---
		Enable support for SVEA RC servo latch/mux helper.
```
